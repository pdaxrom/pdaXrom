## branches/pdaxrom-2.0/boardsetup/Kconfig
```kconfig
# configuration for board setup

menu "Network Configuration         "

config BOARDSETUP_SERVERIP
	string
	prompt "server IP address"
	help
	  Specify your target board's server IP address here.

config BOARDSETUP_TARGETIP
	string
	prompt "target IP address"
	help
	  Specify your target board's IP address here.

config BOARDSETUP_GATEWAY
	string
	prompt "gateway IP"
	help
	  Specify your target board's gateway IP address here.

config BOARDSETUP_NETMASK
	string
	prompt "netmask"
	help
	  Specify your target board's netmask here.

config BOARDSETUP_NFSROOT_PATH
	string
	prompt "nfsroot path"
	default "${PTXDIST_WORKSPACE}/root"
	help
	  Specify path where the target should mount its rootpath via nfs. If you have built a
	  BSP, a reasonalbe value for this field might be the path to the root/ directory under
	  the location of your BSP. Ensure that the above given path is exported by nfs server. 
	  This field will be ignored if you don't use nfsroot. 

config BOARDSETUP_TFTP_PATH
	string
	prompt "tftp path"
	default "/tftpboot"
	help
	  Specify path where the target can fetch files via TFTP. Mostly this
	  is /tftpboot so the default can be used, but it depends on the host distribution. The
	  rootfs's image file will be copied into this directory prior flashing the target.
	  Ensure write permissions into this directory.
endmenu

menu "Host's Serial Configuration   "

config BOARDSETUP_SERIALPORT
	string
	prompt "serial port"
	default "/dev/ttyS0"
	help
	  Specify host's serial port for target connection here.

config BOARDSETUP_SERIALBAUDRATE
	string
	prompt "serial baud rate"
	default "115200"
	help
	  Specify the serial port's baud rate the target is using here.

endmenu

menu "Target flash setup            "

config BOARDSETUP_FLASHIMAGE_KERNEL_START
	string
	prompt "Physical startaddress of kernel in flash"
	default "0x00040000"
	help
	 Specify where in flash the kernel partition begins. This must conform to the
	 partition settings. The default value (0x00040000) corresponds to the quickstart manual.

config BOARDSETUP_FLASHIMAGE_KERNEL_END
	string
	prompt "Physical stopaddress of kernel in flash"
	default "0x0043FFFF"
	help
	 Specify where in flash the kernel partition ends. This must conform to the
	 partition settings and the last writeable address in this partition.
	 The default value (0x0043ffff) corresponds to the quickstart manual.

config BOARDSETUP_FLASHIMAGE_ROOTFS_START
	string
	prompt "Physical startaddress of roofs in flash"
	default "0x00440000"
	help
	 Specify where in flash the rootfs partition begins. This must conform to the
	 partition settings. The default value (0x00440000) corresponds to the quickstart manual.

config BOARDSETUP_FLASHIMAGE_ROOTFS_END
	string
	prompt "Physical stopaddress of roofs in flash"
	default "0x01FFFFFF"
	help
	 Specify where in flash the rootfs partition ends. This must conform to the
	 partition settings and the last writeable address in this partition.
	 The default value (0x01FFFFFF) corresponds to the quickstart manual.

config BOARDSETUP_FLASHIMAGE_RAMSTART
	string
	prompt "First free RAM address"
	default "0xA0200000"
	help
	 Specify the first free space in RAM where to store temporarely the fetched rootfs image.
	 This depends on the target architecture in use and the amount of available RAM.
	 The default value (0xA3000000) corresponds to the quickstart manual.

config BOARDSETUP_FLASHIMAGE_KERNEL_FILE
	string
	prompt "Kernel-image's filename"
	default "./images/linuximage"
	help
	 Specify path and filename of where the kernel image can be found. If you want to change 
	 the default value, Please notice that absolut path does not work here right now. You will 
	 have to work with pathnames relative to the active project by using i.E. "." or ".."  

config BOARDSETUP_FLASHIMAGE_ROOTFS_FILE
	string
	prompt "Rootfs-image's filename"
	default "./images/root.jffs2"
	help
	 Specify path and filename of what file should be wrote into the flash to be used
	 as root fs on the target. If you want to change the default value, Please notice that 
	 absolut path does not work here right now. You will  have to work with pathnames relative to 
	 the active project by using i.E. "." or ".."


endmenu

menu "U-Boot Configuration          "

config BOARDSETUP_UBOOTPROMPT
	string
	prompt "uboot prompt"
	default "uboot> "
	help
	  Specify the uboot prompt here, be careful at this one. Wrong value can cause malfunction
	  on the host side when using ptxdist's test and autosetup features.
	  The value is used in regular expressions to communicate with the target via serial line.

endmenu

menu "Target boot Setting           "

config BOARDSETUP_PARTLAYOUT
	string
	prompt "mtd partition layout"
# default "0x00000000:0x00040000:0x00440000:0x02000000"
	default " 0x00000000:0x00180000:0x01f00000:0x01f40000:0x02000000"
	help
	  Specify the Partitionlayout on your mtd device here. The format used is 
	  BEGIN:RANGE_OF_A_PARTITION:RANGE_OF_A_PARTITION:.... Ensure to give 
	  0x00000000 as the beginning of the string.
	  FIXME: Be sure to give lower case letters for hex numbers

endmenu
```
